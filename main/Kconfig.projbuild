## main/Kconfig.projbuild
```kconfig
menu "Road Hog SMS control"

config ROADHOG_SMS_CONTROL
    bool "Enable SMS commands"
    default y

endmenu

config ROADHOG_STATUS_LED_GPIO
    int "Onboard RGB status LED GPIO"
    range 0 48
    default 38
    help
        Use GPIO38 for ESP32-S3-DevKitC-1 v1.1, or GPIO48 for the original revision.

menu "Road Hog LTE diagnostic"

config ROADHOG_LTE_DIAGNOSTIC
    bool "Run one LTE PPP diagnostic per boot"
    depends on COMPILER_CXX_EXCEPTIONS && ESP_MODEM_USE_PPP_MODE && LWIP_PPP_ENABLE_IPV4
    depends on MBEDTLS_CERTIFICATE_BUNDLE && MBEDTLS_HAVE_TIME_DATE && ESP_HTTP_CLIENT_ENABLE_HTTPS
    depends on !ESP_TLS_SKIP_SERVER_CERT_VERIFY
    select ESP_NETIF_SET_DNS_PER_DEFAULT_NETIF
    default n

config ROADHOG_LTE_DELAY
    int "Seconds of AT/SMS service before the diagnostic"
    depends on ROADHOG_LTE_DIAGNOSTIC
    range 30 600
    default 90

endmenu

menu "Road Hog OTA rollback bench"
    depends on BOOTLOADER_APP_ROLLBACK_ENABLE

config ROADHOG_OTA_BENCH_BOOT_PEER
    bool "Select an untried, serial-staged ota_1 from healthy ota_0"
    default n
    help
        Bench only. After healthy ota_0 is confirmed as the selected VALID
        baseline, select an already staged ota_1 with no state entry and reboot.
        Keep disabled outside testing.

config ROADHOG_OTA_BENCH_REJECT_PENDING
    bool "Reject a pending image to demonstrate rollback"
    depends on !ROADHOG_OTA_BENCH_BOOT_PEER
    default n
    help
        Bench only. Force a failed health result for a pending image.

endmenu

menu "Road Hog LTE OTA bench"
    depends on ROADHOG_LTE_DIAGNOSTIC && BOOTLOADER_APP_ROLLBACK_ENABLE && ROADHOG_SMS_CONTROL

config ROADHOG_OTA_UPDATE_BENCH
    bool "Enable explicit serial-console LTE OTA commands"
    depends on !ROADHOG_OTA_BENCH_BOOT_PEER && !ROADHOG_OTA_BENCH_REJECT_PENDING && ESP_CONSOLE_UART
    default n

config ROADHOG_OTA_SMS_BENCH
    bool "Enable owner-confirmed OTA over SMS for attended bench testing"
    depends on ROADHOG_OTA_UPDATE_BENCH
    default n

config ROADHOG_OTA_SMS_RELEASE_BASE
    string "HogBarn HTTPS release base URL (without trailing slash)"
    depends on ROADHOG_OTA_SMS_BENCH
    default ""
    help
        Must be explicitly configured. Add the exact HogBarn hostname to
        the OTA HTTPS allowlist. SMS uses latest/ and vN/ under this base.

config ROADHOG_MODEM_MAINTENANCE_BENCH
    bool "Enable constrained local SIM7600 maintenance commands"
    depends on ROADHOG_OTA_UPDATE_BENCH && ESP_MAIN_TASK_STACK_SIZE >= 6144
    default n
    help
        Bench only. Uses the normal UART owner with a larger main stack.

config ROADHOG_OTA_RELEASE_BASE
    string "Release asset base URL (without trailing slash)"
    depends on ROADHOG_OTA_UPDATE_BENCH
    default "https://github.com/sshorba/roadhog/releases/download"

config ROADHOG_OTA_RELEASE_HOSTS
    string "Exact allowed HTTPS hostnames, comma separated"
    depends on ROADHOG_OTA_UPDATE_BENCH
    default "github.com,release-assets.githubusercontent.com"

endmenu
```
